## drivers/input/touchscreen/cst128a_cust/Kconfig
```kconfig
config TOUCHSCREEN_CST128A_CUST
        tristate "CST128A Touchscreen"
	depends on I2C
	default n
	help
	  Say Y here if you have CST128A touch panel.
	  If unsure, say N.
```
